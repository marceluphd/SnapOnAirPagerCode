//
// SnapOnAir Dr CADIC Philippe
// 1.8 inch Pager
// (C)2020 
//

// Display configurationb
#include <bb_uc1701.h>

#define DC_PIN 12
#define CS_PIN 14
#define RST_PIN 15
#define MOSI_PIN 19
#define SCK_PIN 18
#define LED_PIN 27 
#define FLIP180 0
#define INVERT 0

/*
1.8 INCH DISPLAY - SPI CONFIGURATION OF THE DEVICE
SCK : 18
MISO: 19
MOSI: 23
CS: 14
CD 12
RESET 15
LED: 27 
 */

// BUTTONS Configuration
const int button1Pin = 34;     // the number of the pushbutton 1 (left)
const int button2Pin = 35;     // the number of the pushbutton 2 (right)

// LED COnfiguration
#define MSGLED 4  (LED - Top RIGHT)

// ROTARY ENCODER Configuration
// LEFT 33 , RIGHT 25
#define ROTLEFT 33
#define ROTRIGHT 25
#define ROTPUSH 26

// MENU Definition
String mnuhome1 = "READ MSGs";
String mnuhome2 = "Write a MSG";
String mnuhome3 = "Settings";
String mnuhome4 = "Mute / DIM";
String mnuhome5 = "Default RCV";
String mnuhome6 = "About...";

// Buzzer configuration
int freq = 2000;
int channel = 0;
int resolution = 8;

// MENU Level
int menuLevel = 1;
int menuPosition = 1;

// Rotary
int counter = 0;
int state;
int Laststate; 
int pushevent=0;

// Sound / Mute / DIM
int soundOn=1;
int dimOn=1;

// CHIP ID
uint64_t chipid;  
String IDnumber;


const uint8_t ucBitmap[] PROGMEM = {
  0x42,0x4d,0x82,0x04,0x00,0x00,0x00,0x00,0x00,0x00,0x82,0x00,0x00,0x00,0x6c,0x00,
  0x00,0x00,0x80,0x00,0x00,0x00,0x40,0x00,0x00,0x00,0x01,0x00,0x01,0x00,0x00,0x00,
  0x00,0x00,0x00,0x04,0x00,0x00,0x23,0x2e,0x00,0x00,0x23,0x2e,0x00,0x00,0x02,0x00,
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  0x00,0x00
};


// functions to power backlight LED on/off 
void lightoff(){ // power the backlinght LED OFF
  digitalWrite(LED_PIN, LOW);  
  };
  
void lighton(){ // power the backlinght LED OFF
  digitalWrite(LED_PIN, HIGH);  
  };


// Sound on off function
void rotarybeep(int channel, int freq, int dura){
  // makes a small noise (if no MUTE on) freq in hz and duration in msec
  ledcWriteTone(channel, freq);
  delay(dura);
  ledcWriteTone(channel, 0);
  };


// Menu fonctions

void menuAbout(){
  // This displays the credits
    uc1701Fill(0);
    uc1701WriteString(0,1,(char *)"SnapOnAir Pager", 0, FONT_NORMAL);
    uc1701WriteString(0,2,(char *)"  Dr CADIC Ph.", 0, FONT_NORMAL);
    uc1701WriteString(0,3,(char *)"  snaponair.com", 0, FONT_NORMAL);
    uc1701WriteString(0,4,(char *)"   @pwarobot", 0, FONT_NORMAL);
    uc1701WriteString(0,6,(char *)"Free int'l Txt", 0, FONT_NORMAL);
    uc1701WriteString(0,7,(char *)"MESH/LoRA Netwrk", 0, FONT_NORMAL);
    
    delay (200);

 
    
  };



void menuSettings(String IDnumber){ // Menu du select all settings - Will save in memory when closed
    uc1701Fill(0);
    uc1701WriteString(0,0,(char *)" ** Settings **", 0, FONT_NORMAL);
    uc1701WriteString(0,1,(char *)"SnapID:", 0, FONT_NORMAL);
    uc1701WriteString(65,1,(char *)IDnumber.c_str(), 0, FONT_NORMAL);    
    uc1701WriteString(0,2,(char *)"Name:", 0, FONT_NORMAL);
    uc1701WriteString(0,3,(char *)"WIFI:", 0, FONT_NORMAL);
    uc1701WriteString(0,4,(char *)"LoRA", 0, FONT_NORMAL);
    uc1701WriteString(0,5,(char *)"MeSH", 0, FONT_NORMAL);
    uc1701WriteString(0,6,(char *)"Freq:", 0, FONT_NORMAL);
    uc1701WriteString(0,7,(char *)"Misc.", 0, FONT_NORMAL);
  };

  

void mainmenu(int menuPosition){


  // Concat menu position
  String zeposition = "Position="+String(menuPosition);
  // Display the first menu
  uc1701Fill(0);
  if (menuPosition==1) {
    // Selected
    uc1701WriteString(0,1,(char *)mnuhome1.c_str(), 0, FONT_SMALL);
    }
    else
    {
    uc1701WriteString(0,1,(char *)mnuhome1.c_str(), 0, FONT_NORMAL);
    }
    
  if (menuPosition==2) {
    // Selected
    uc1701WriteString(0,2,(char *)mnuhome2.c_str(), 0, FONT_SMALL);
    }
    else
    {
    uc1701WriteString(0,2,(char *)mnuhome2.c_str(), 0, FONT_NORMAL);
    }
  
  if (menuPosition==3) {
    // Selected
    uc1701WriteString(0,3,(char *)mnuhome3.c_str(), 0, FONT_SMALL);
    }
    else
    {
    uc1701WriteString(0,3,(char *)mnuhome3.c_str(), 0, FONT_NORMAL);
    }
  
  if (menuPosition==4) {
    // Selected
    uc1701WriteString(0,4,(char *)mnuhome4.c_str(), 0, FONT_SMALL);
    }
    else
    {
    uc1701WriteString(0,4,(char *)mnuhome4.c_str(), 0, FONT_NORMAL);
    }
  
  if (menuPosition==5) {
    // Selected
    uc1701WriteString(0,5,(char *)mnuhome5.c_str(), 0, FONT_SMALL);
    }
    else
    {
    uc1701WriteString(0,5,(char *)mnuhome5.c_str(), 0, FONT_NORMAL);
    }

  
  if (menuPosition==6) {
    // Selected
    uc1701WriteString(0,6,(char *)mnuhome6.c_str(), 0, FONT_SMALL);
    }
    else
    {
    uc1701WriteString(0,6,(char *)mnuhome6.c_str(), 0, FONT_NORMAL);
    }  
  
  
  
  }
 






void setup() {
  // put your setup code here, to run once:
   uc1701Init(DC_PIN, RST_PIN, LED_PIN, CS_PIN, MOSI_PIN, SCK_PIN, FLIP180, INVERT, -1);
   uc1701SetContrast(235);
   uc1701Fill(0);

   uc1701LoadBMP((uint8_t *)ucBitmap);
   delay(2000);
   uc1701Fill(0);

   uc1701WriteString(0,0,(char *)"  snaponair.com", 0, FONT_NORMAL);
   uc1701WriteString(0,1,(char *)"MeSH/LoRA 868mhz", 0, FONT_NORMAL);
   
   uc1701WriteString(0,3,(char *)"Rcv:326 UnR:2", 0, FONT_NORMAL);
   uc1701WriteString(0,4,(char *)"Sent: 367", 0, FONT_NORMAL);
   uc1701WriteString(0,5,(char *)"WIFI+ LORA+ BT+", 0, FONT_NORMAL);
   
   

  
   
   
   pinMode(ROTLEFT,INPUT);
   pinMode(ROTRIGHT,INPUT);
   pinMode(ROTPUSH,INPUT);

   // Buzzer config
   ledcSetup(channel, freq, resolution);
   ledcAttachPin(32, channel);

   Laststate = 0;

   // GET chip ID 
   chipid=ESP.getEfuseMac();
   IDnumber= String((uint32_t)ESP.getEfuseMac(), HEX);
   if (soundOn==1){rotarybeep(0, 100, 10);};
   
}

void loop() {
  //  We get the rotary encoder if rotary is activated then we refressh the menu
  
 state = digitalRead(ROTLEFT);
  if(state != Laststate)
  {
    Laststate = state;
    menuPosition=menuPosition+1;
    if (soundOn==1){rotarybeep(0, 100, 10);};
    if (menuPosition >= 6) {menuPosition=6;};

    // refresh display menuPosition
    mainmenu(menuPosition);
    
  }
  
 state = digitalRead(ROTRIGHT);
  if(state != Laststate)
  {
    Laststate = state;
    menuPosition=menuPosition-1;
   if (soundOn==1){rotarybeep(0, 200, 10);};  
    if (menuPosition <= 1) {menuPosition=1;};

    // refresh display menuPosition
    mainmenu(menuPosition);
    
  }

 state = digitalRead(ROTPUSH);
  if(state == LOW)
  {
    // We go su submenus
  if (soundOn==1){rotarybeep(0, 100, 10);};
  
  // Now we check if we go submenus

   // Menu 3
      if (menuPosition ==3){ // We show the setting menu
      menuSettings(IDnumber);
    };

   // Menu 4
   if (menuPosition ==4){// We sound off
    if (soundOn==1){
      soundOn=0;
      delay(400);
      lightoff(); //we also power LED off
      } else {
      soundOn=1;
      delay(400);
      lighton();
      };
            
    };

   
  
   // Menu 6
   if (menuPosition ==6){// We show the ABOUT menu
    menuAbout();
    };

    
  }


   

}
